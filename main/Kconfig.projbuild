## main/Kconfig.projbuild
```kconfig
menu "Ghost ESP Options"

    menu "LED Options"
    
    config USE_NEOPIXEL
        bool "Use Neopixel RGB LEDs"
        default n
        help
            Enable Neopixel RGB LED support. When enabled, a single data pin will be used for RGB control.
    
    config LED_DATA_PIN
        int "LED Data Pin"
        default 0
        depends on USE_NEOPIXEL
        help
            Set the data pin for Neopixel LEDs.
    
    config NUM_LEDS
        int "Number of LEDs"
        default 0
        help
            Set the number of LEDs connected.
    
    config RED_RGB_PIN
        int "Red RGB Pin"
        default 0
        depends on !USE_NEOPIXEL
        help
            Define the pin for the red color of RGB LED when not using Neopixel.
    
    config GREEN_RGB_PIN
        int "Green RGB Pin"
        default 0
        depends on !USE_NEOPIXEL
        help
            Define the pin for the green color of RGB LED when not using Neopixel.
    
    config BLUE_RGB_PIN
        int "Blue RGB Pin"
        default 0
        depends on !USE_NEOPIXEL
        help
            Define the pin for the blue color of RGB LED when not using Neopixel.
    
    endmenu
    
    menu "Display Options"
    
    config WITH_SCREEN
        bool "Enable Screen Support"
        default y
        help
            Enable or disable screen support.
    
    config TFT_WIDTH
        int "TFT Width"
        default 240
        depends on WITH_SCREEN
        help
            Set the width of the TFT display.
    
    config TFT_HEIGHT
        int "TFT Height"
        default 280
        depends on WITH_SCREEN
        help
            Set the height of the TFT display.
    
    config USE_TOUCHSCREEN
        bool "Enable Touchscreen"
        default y
        help
            Enable touchscreen input.
    
    config Waveshare_LCD
        bool "Enable Waveshare LCD"
        default y
        help
            Enable support for Waveshare LCD.

    config ESP32S3R8_PIN_NUM_DISPLAY_DC
        int "LCD DC Pin"
        default 4
        help
            Define the pin for the LCD DC signal.

    config ESP32S3R8_PIN_NUM_DISPLAY_CS
        int "LCD CS Pin"
        default 5
        help
            Define the pin for the LCD CS signal.

    config ESP32S3R8_PIN_NUM_DISPLAY_SCLK
        int "LCD SCLK Pin"
        default 6
        help
            Define the pin for the LCD SPI clock.

    config ESP32S3R8_PIN_NUM_DISPLAY_MOSI
        int "LCD MOSI Pin"
        default 7
        help
            Define the pin for the LCD SPI data.

    config ESP32S3R8_PIN_NUM_DISPLAY_RST
        int "LCD Reset Pin"
        default 8
        help
            Define the pin for the LCD reset signal.

    config ESP32S3R8_PIN_NUM_DISPLAY_BCKL
        int "LCD Backlight Pin"
        default 15
        help
            Define the pin for the LCD backlight control.

    config ESP32S3R8_PIN_NUM_TOUCH_SCL
        int "Touch SCL Pin"
        default 10
        help
            Define the pin for the touchscreen I2C clock.

    config ESP32S3R8_PIN_NUM_TOUCH_SDA
        int "Touch SDA Pin"
        default 11
        help
            Define the pin for the touchscreen I2C data.

    config ESP32S3R8_PIN_NUM_TOUCH_RST
        int "Touch Reset Pin"
        default 13
        help
            Define the pin for the touchscreen reset signal.

    config ESP32S3R8_PIN_NUM_TOUCH_INT
        int "Touch Interrupt Pin"
        default 14
        help
            Define the pin for the touchscreen interrupt signal.

    endmenu

    menu "Peripheral Options"

    config HAS_BATTERY
        bool "Enable Battery Management"
        default y
        help
            Enable battery management features.

    config ESP32S3R8_HAS_BATTERY_ETA6098
        bool "Enable ETA6098 Battery Manager"
        default y
        depends on HAS_BATTERY
        help
            Enable support for the ETA6098 battery management IC.

    config HAS_RTC_CLOCK
        bool "Enable RTC Clock"
        default y
        help
            Enable RTC Clock.

    config ESP32S3R8_HAS_RTC_PCF85063
        bool "Enable PCF85063 RTC"
        default y
        depends on HAS_RTC_CLOCK
        help
            Enable support for the PCF85063 RTC chip.

    config ESP32S3R8_HAS_IMU_QMI8658
        bool "Enable QMI8658 IMU"
        default y
        help
            Enable support for the QMI8658 6-axis IMU.

    config ESP32S3R8_PIN_NUM_BUZZER
        int "Buzzer Pin"
        default 42
        help
            Define the pin for the buzzer.

    endmenu

    menu "Misc Options"

        config HAS_BATTERY
            bool "Enable power saving"
            default n
            help
                Enable power saving features if you have a battery.
    
        config HAS_RTC_CLOCK
            bool "Enable RTC Clock"
            default n
            help
                Enable RTC Clock.

        config WITH_ETHERNET
            bool "Enable Ethernet Support"
            default n
            help
                Enable Ethernet Support.   
            
        config IS_GHOST_BOARD
            bool "Enable Ghost Board Configuration"
            default n
            help
                Enable configuration for Ghost board.

    endmenu
    
    menu "GPS Configuration"
    
    config HAS_GPS
        bool "Enable GPS"
        default n
        help
            Enable GPS support.
    
    config GPS_UART_RX_PIN
        int "GPS UART RX Pin"
        default 16
        depends on HAS_GPS
        help
            Define the UART RX pin for GPS.


    config NMEA_PARSER_RING_BUFFER_SIZE
        int "NMEA Parser Ring Buffer Size"
        range 0 2048
        depends on HAS_GPS
        default 1024
        help
            Size of the ring buffer used for UART Rx channel.

    config NMEA_PARSER_TASK_STACK_SIZE
        int "NMEA Parser Task Stack Size"
        range 0 4096
        depends on HAS_GPS
        default 3072
        help
            Stack size of NMEA Parser task.

    config NMEA_PARSER_TASK_PRIORITY
        int "NMEA Parser Task Priority"
        range 0 24
        depends on HAS_GPS
        default 2
        help
            Priority of NMEA Parser task.

    menu "NMEA Statement Support"
        comment "At least one statement must be selected"
        config NMEA_STATEMENT_GGA
            bool "GGA Statement"
            default y
            depends on HAS_GPS
            help
                Enabling this option will parse the following parameter from GGA statement:

                - Latitude, Longitude, Altitude;
                - Number of satellites in use, fix status (no fix, GPS, DGPS), UTC time;

        config NMEA_STATEMENT_GSA
            bool "GSA Statement"
            default y
            depends on HAS_GPS
            help
                Enabling this option will parse the following parameter from GSA statement:

                - Position/Vertical/Horizontal dilution of precision;
                - Fix mode (no fix, 2D, 3D fix);
                - IDs of satellites in use;

        config NMEA_STATEMENT_GSV
            bool "GSV Statement"
            default y
            depends on HAS_GPS
            help
                Enabling this option will parse the following parameter from GSV statement:

                - Number of satellites in view;
                - Optional details of each satellite in view;

        config NMEA_STATEMENT_RMC
            bool "RMC Statement"
            default y
            depends on HAS_GPS
            help
                Enabling this option will parse the following parameter from RMC statement:

                - Validity of GPS signal;
                - Ground speed (knots) and course over ground (degrees);
                - Magnetic variation;
                - UTC date;

        config NMEA_STATEMENT_GLL
            bool "GLL Statement"
            default y
            depends on HAS_GPS
            help
                Enabling this option will parse the following parameter from GLL statement:

                - Latitude, Longitude;
                - UTC time;

        config NMEA_STATEMENT_VTG
            bool "VTG Statement"
            default y
            depends on HAS_GPS
            help
                Enabling this option will parse the following parameter from VTG statement:

                - Ground speed (knots, km/h) and course over ground (degrees);
                - Magnetic variation;

    endmenu
    
    endmenu
    
    menu "SPI and MMC Configuration"
    
    config USING_SPI
        bool "Enable SPI"
        default n
        help
            Enable SPI communication.
    
    config USING_MMC
        bool "Enable MMC"
        default n
        help
            Enable MMC support.

    config USING_MMC_1_BIT
        bool "Enable MMC (1-bit mode)"
        default n
        help
            Enable MMC support (1-bit mode).
    
    config SD_SPI_CS_PIN
        int "SD Card SPI CS Pin"
        default 4
        depends on USING_SPI
        help
            Define the Chip Select (CS) pin for SD Card SPI.
    
    config SD_SPI_CLK_PIN
        int "SD Card SPI CLK Pin"
        default 18
        depends on USING_SPI
        help
            Define the Clock (CLK) pin for SD Card SPI.
    
    config SD_SPI_MISO_PIN
        int "SD Card SPI MISO Pin"
        default 19
        depends on USING_SPI
        help
            Define the MISO pin for SD Card SPI.
    
    config SD_SPI_MOSI_PIN
        int "SD Card SPI MOSI Pin"
        default 23
        depends on USING_SPI
        help
            Define the MOSI pin for SD Card SPI.

    config SD_MMC_D0 
        int "SD Card D0 Pin"
        default 13
        depends on USING_MMC_1_BIT
        help
            Define the MOSI pin for SD Card SPI.
            
    config SD_MMC_CLK
        int "SD Card CLK Pin"
        default 12
        depends on USING_MMC_1_BIT
        help
            Define the MISO pin for SD Card SPI.
            
    config SD_MMC_CMD 
        int "SD Card CMD Pin"
        default 11
        depends on USING_MMC_1_BIT
        help
            Define the MOSI pin for SD Card SPI.
    
    endmenu
    
endmenu
```
